## build/conf/bblayers.conf
```bitbake
# POKY_BBLAYERS_CONF_VERSION is increased each time build/conf/bblayers.conf
# changes incompatibly
POKY_BBLAYERS_CONF_VERSION = "2"

BBPATH = "${TOPDIR}"
BFILES ?= ""

BBLAYERS ?= " \
  ${BBPATH}/../sources/poky/meta \
  ${BBPATH}/../sources/poky/meta-poky \
  ${BBPATH}/../sources/poky/meta-yocto-bsp \
  ${BBPATH}/../sources/meta-raspberrypi \
  ${BBPATH}/../sources/meta-openembedded/meta-oe \
  ${BBPATH}/../sources/meta-openembedded/meta-multimedia \
  ${BBPATH}/../sources/meta-openembedded/meta-networking \
  ${BBPATH}/../sources/meta-openembedded/meta-python \
  ${BBPATH}/../sources/meta-hello-yocto \
  "
```

## sources/meta-hello-yocto/conf/layer.conf
```bitbake
# We have a conf and classes directory, add to BBPATH
BBPATH .= ":${LAYERDIR}"

# We have recipes-* directories, add to BBFILES
BBFILES += "${LAYERDIR}/recipes-*/*/*.bb \
            ${LAYERDIR}/recipes-*/*/*.bbappend"

BBFILE_COLLECTIONS += "meta-hello-yocto"
BBFILE_PATTERN_meta-hello-yocto = "^${LAYERDIR}/"
BBFILE_PRIORITY_meta-hello-yocto = "6"

LAYERDEPENDS_meta-hello-yocto = "core"
LAYERSERIES_COMPAT_meta-hello-yocto = "scarthgap"
```
